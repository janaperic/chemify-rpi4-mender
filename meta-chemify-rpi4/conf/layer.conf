## meta-chemify-rpi4/conf/layer.conf
```bitbake
BBPATH .= ":${LAYERDIR}"
BBFILES += "${LAYERDIR}/recipes-*/*/*.bb ${LAYERDIR}/recipes-*/*/*.bbappend"
BBFILE_COLLECTIONS += "chemify-rpi4"
BBFILE_PATTERN_chemify-rpi4 = "^${LAYERDIR}/"
BBFILE_PRIORITY_chemify-rpi4 = "20"
LAYERSERIES_COMPAT_chemify-rpi4 = "scarthgap"
```
